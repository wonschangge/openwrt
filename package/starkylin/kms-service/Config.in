## package/starkylin/kms-service/Config.in
```kconfig
menu "KMS-Service Configuration"

config KMS_SERVICE
    bool "Customize kms-service options"
    default y
    help
        Enabling kms-service.
```

## package/starkylin/swupdate/Config.in
```kconfig
if PACKAGE_swupdate


config SWUPDATE_CUSTOM
	bool "Customize swupdate options"
	default n
	help
		Enabling this allows full customization of swupdate settings.

if SWUPDATE_CUSTOM
	source "config/Config.in"
endif

endif
```

## package/starkylin/swupdate/config/Config.in
```kconfig
# SPDX-FileCopyrightText: 2013 Stefano Babic <sbabic@denx.de>
#
# SPDX-License-Identifier: GPL-2.0-only

#
# For a description of the syntax of this configuration file,
# see scripts/kbuild/config-language.txt.
#

menu "SWUpdate Configuration"

config SWUPDATE_HAVE_LINUX
	bool
	default y
	#option env="HAVE_LINUX"

config SWUPDATE_HAVE_FREEBSD
	bool
	default n
	#option env="HAVE_FREEBSD"

config SWUPDATE_HAVE_LUA
	bool
	default y
	#option env="HAVE_LUA"

config SWUPDATE_HAVE_LIBCONFIG
	bool
	default y
	#option env="HAVE_LIBCONFIG"

config SWUPDATE_HAVE_LIBARCHIVE
	bool
	default y
	#option env="HAVE_LIBARCHIVE"

config SWUPDATE_HAVE_LIBCURL
	bool
	default y
	#option env="HAVE_LIBCURL"

config SWUPDATE_HAVE_LIBFDISK
	bool
	default y
	#option env="HAVE_LIBFDISK"

config SWUPDATE_HAVE_LIBBLKID
	bool
	default y
	#option env="HAVE_LIBBLKID"

config SWUPDATE_HAVE_LIBGPIOD
	bool
	default y
	#option env="HAVE_LIBGPIOD"

config SWUPDATE_HAVE_LIBMTD
	bool
	default y
	#option env="HAVE_LIBMTD"

config SWUPDATE_HAVE_LIBUBI
	bool
	default y
	#option env="HAVE_LIBUBI"

config SWUPDATE_HAVE_LIBUBOOTENV
	bool
	default y
	#option env="HAVE_LIBUBOOTENV"

config SWUPDATE_HAVE_LIBEBGENV
	bool
	default y
	#option env="HAVE_LIBEBGENV"
	#not add lib

config SWUPDATE_HAVE_LIBTEGRABOOT_TOOLS
	bool
	default y
	#option env="HAVE_LIBTEGRABOOT_TOOLS"
	#not add lib

config SWUPDATE_HAVE_LIBEXT2FS
	bool
	default y
	#option env="HAVE_LIBEXT2FS"

config SWUPDATE_HAVE_LIBBTRFS
	bool
	default y
	#option env="HAVE_LIBBTRFS"

config SWUPDATE_HAVE_LIBZEROMQ
	bool
	default y
	#option env="HAVE_LIBZEROMQ"
	#not add lib

config SWUPDATE_HAVE_ZLIB
	bool
	default y
	#option env="HAVE_ZLIB"

config SWUPDATE_HAVE_ZSTD
	bool
	default y
	#option env="HAVE_ZSTD"

config SWUPDATE_HAVE_LIBSSL
	bool
	default y
	#option env="HAVE_LIBSSL"

config SWUPDATE_HAVE_LIBSYSTEMD
	bool
	default y
	#option env="HAVE_LIBSYSTEMD"

config SWUPDATE_HAVE_LIBCRYPTO
	bool
	default y
	#option env="HAVE_LIBCRYPTO"

config SWUPDATE_HAVE_WOLFSSL
	bool
	default y
	#option env="HAVE_WOLFSSL"
	#not add lib

config SWUPDATE_HAVE_MBEDTLS
	bool
	default y
	#option env="HAVE_MBEDTLS"
	#not add lib

config SWUPDATE_HAVE_P11KIT
	bool
	default y
	#option env="HAVE_P11KIT"
	#not add lib

config SWUPDATE_HAVE_LIBWEBSOCKETS
	bool
	default y
	#option env="HAVE_LIBWEBSOCKETS"

config SWUPDATE_HAVE_LIBRSYNC
	bool
	default y
	#option env="HAVE_LIBRSYNC"

config SWUPDATE_HAVE_URIPARSER
	bool
	default y
	#option env="HAVE_URIPARSER"

config SWUPDATE_HAVE_ZCK
	bool
	default y
	#option env="HAVE_ZCK"

menu "SWUpdate Settings"

menu "General Configuration"

config SWUPDATE_CURL
	bool
	default n

config SWUPDATE_CURL_SSL
	bool
	default n

config SWUPDATE_DISKFORMAT
	bool
	default n

config SWUPDATE_SYSTEMD
	bool "enable systemd support"
	depends on SWUPDATE_HAVE_LINUX
	depends on SWUPDATE_HAVE_LIBSYSTEMD
	default n
	help
	  Enable support for systemd's start-up completion
	  notification and socket-based activation features.

comment "systemd support needs libsystemd"
	depends on !SWUPDATE_HAVE_LIBSYSTEMD && SWUPDATE_HAVE_LINUX

config SWUPDATE_DEFAULT_CONFIG_FILE
	string "File with default settings"
	default "/etc/swupdate.cfg"
	help
	  SWUpdate may get its default configuration settings
	  from the specified file (if present). Users may
	  override the default configuration with the -f
	  option switch.

config SWUPDATE_SCRIPTS
	bool "enable pre and postinstall scripts"
	default y
	help
	  Enabling this option, the installer will run
	  pre- and postinstall scripts, if they are present
	  in the image. For security reason, this option
	  can be switched off.

config SWUPDATE_HW_COMPATIBILITY
	bool "check for hardware / software compatibility"
	default n
	help
	  If enabled, check if the hardware revision
	  supports the software version. Detecting the hardware
	  revision is very board specific, and it cannot be generalized.
	  For this reason, the software expects that the detected
	  version is written into a file by a previous software.

config SWUPDATE_HW_COMPATIBILITY_FILE
	string "File with detected hardware revisions"
	depends on SWUPDATE_HW_COMPATIBILITY
	default "/etc/hwrevision"
	help
	  File where to read the detected hardware revsion
	  that must be compared with the software version.
	  The file has simple entries (one per line) in the
	  format of "major.minor".

config SWUPDATE_SW_VERSIONS_FILE
	string "File with detected software version"
	default "/etc/sw-versions"
	help
	  This is an optional file that is scanned at the
	  beginning to read the installed versions of
	  all sw-components. Each entry in the file is
	  a pair of "name version".
	  In sw-description,  an image can have the
	  optional attributes:
		"name" : key for searching in SW_VERSIONS_FILE
		"version" : version contained in the .swu
		"install-if-different" : if set, the version
			is compared with the one in SW_VERSIONS_FILE.
	  The image is installed only if there is a version mismatch.
	  This reduces the risk in case of components that are not
	  safe to update, such as the bootloader. Updating it is a risk,
	  but in some cases it is required to do it. Having a check,
	  the risky-component is not always updated.

menu "Socket Paths"

config SWUPDATE_SOCKET_CTRL_PATH
	string "SWUpdate control socket path"
	help
	  Path to SWUpdate's IPC socket.

config SWUPDATE_SOCKET_PROGRESS_PATH
	string "SWUpdate progress socket path"
	help
	  Path to the socket progress information is sent to.

config SWUPDATE_SOCKET_NOTIFIER_DIRECTORY
	string "SWUpdate notifier socket directory"
	depends on SWUPDATE_HAVE_FREEBSD
	default "/tmp/"
	help
	  Path to SWUpdate's notifier sockets on FreeBSD as
	  Linux-like abstract sockets are not available.

endmenu

config SWUPDATE_MTD
	bool "MTD support"
	default n
	depends on SWUPDATE_HAVE_LINUX
	depends on SWUPDATE_HAVE_LIBMTD
	help
	  Enable MTD support.

comment "MTD support needs libmtd"
	depends on !SWUPDATE_HAVE_LIBMTD && SWUPDATE_HAVE_LINUX

config SWUPDATE_LUA
	bool "lua"
	default n
	depends on SWUPDATE_HAVE_LUA
	help
	  Enable Lua interpreter.

comment "Lua support needs a Lua interpreter"
	depends on !SWUPDATE_HAVE_LUA

config SWUPDATE_LUAPKG
	string "Lua pkg-config SWUPDATE_name"
	default "lua"
	depends on SWUPDATE_LUA
	help
	  Which pkg-config SWUPDATE_package supplies the Lua API.

# These are auto-selected by other options

config SWUPDATE_FEATURE_SYSLOG
	bool #No description makes it a hidden option
	default n
	#help
	#  This option is auto-selected when you select any applet which may
	#  send its output to syslog. You do not need to select it manually.

endmenu

menu 'Build Options'

config SWUPDATE_CROSS_COMPILE
	string "Cross Compiler prefix"
	default ""
	help
	  If you want to build swupdate with a cross compiler, then you
	  will need to set this to the cross-compiler prefix, for example,
	  "i386-uclibc-".

	  Native builds leave this empty.

config SWUPDATE_SYSROOT
	string "Path to sysroot"
	default ""
	help
	  If you want to build swupdate with a cross compiler, then you
	  might also need to specify where /usr/include and /usr/lib
	  will be found.

	  For example, swupdate can be built against an installed
	  Android NDK, platform version 9, for ARM ABI with

	  CONFIG_SYSROOT=/opt/android-ndk/platforms/android-9/arch-arm

	  Native builds leave this empty.

config SWUPDATE_EXTRA_CFLAGS
	string "Additional CFLAGS"
	default ""
	help
	  Additional CFLAGS to pass to the compiler verbatim.

config SWUPDATE_EXTRA_LDFLAGS
	string "Additional LDFLAGS"
	default ""
	help
	  Additional LDFLAGS to pass to the linker verbatim.

config SWUPDATE_EXTRA_LDLIBS
	string "Additional LDLIBS"
	default ""
	help
	  Additional LDLIBS to pass to the linker with -l.

endmenu

menu 'Debugging Options'

config SWUPDATE_DEBUG
	bool "Build SWUpdate with extra Debugging symbols"
	default n
	help
	  Say Y here if you wish to examine swupdate internals while applets are
	  running. This increases the size of the binary considerably, and
	  should only be used when doing development. If you are doing
	  development and want to debug swupdate, answer Y.

	  Most people should answer N.

config SWUPDATE_DEBUG_PESSIMIZE
	bool "Disable compiler optimizations"
	default n
	depends on SWUPDATE_DEBUG
	help
	  The compiler's optimization of source code can eliminate and reorder
	  code, resulting in an executable that's hard to understand when
	  stepping through it with a debugger. This switches it off, resulting
	  in a much bigger executable that more closely matches the source
	  code.

config SWUPDATE_WERROR
	bool "Abort compilation on any warning"
	default n
	help
	  Selecting this will add -Werror to gcc command line.

	  Most people should answer N.

config SWUPDATE_NOCLEANUP
	bool "Do not remove temporary files after execution"
	default n
	help
	  After each run, temporary files are removed from the directory
	  pointed to by the environment variable TMPDIR (/tmp as fallback
	  if unset) to restart in a clean state. For debugging purposes, it
	  helps to check the consistency of the files extracted by SWUpdate.
	  For production, answer N.

endmenu

endmenu

comment "Bootloader support"

source "bootloader/Config.in"


comment "Interfaces"

config SWUPDATE_DOWNLOAD
	bool "Enable image downloading"
	default n
	depends on SWUPDATE_HAVE_LIBCURL
	help
	  Enable update from image URL using libcurl. The stream is sent via IPC
	  to the installer as it is done for other interfaces.

comment "Image downloading support needs libcurl"
	depends on !SWUPDATE_HAVE_LIBCURL

config SWUPDATE_DOWNLOAD_SSL
	bool "Enable SSL support for image downloading"
	default n
	depends on SWUPDATE_DOWNLOAD
	depends on SWUPDATE_SSL_IMPL_OPENSSL || SWUPDATE_SSL_IMPL_WOLFSSL || SWUPDATE_SSL_IMPL_MBEDTLS
	select SWUPDATE_CHANNEL_CURL_SSL
	help
	  Enable SSL support in channels using libcurl.

comment "DOWNLOADING SSL support needs an SSL implementation"
	depends on SWUPDATE_DOWNLOAD && !(SWUPDATE_SSL_IMPL_OPENSSL || SWUPDATE_SSL_IMPL_WOLFSSL || SWUPDATE_SSL_IMPL_MBEDTLS)

config SWUPDATE_CHANNEL_CURL
	bool
	depends on SWUPDATE_HAVE_LIBCURL
	select SWUPDATE_CURL

source "suricatta/Config.in"

source "mongoose/Config.in"

comment "Security"

choice
	prompt "SSL implementation to use"
	default SWUPDATE_SSL_IMPL_NONE
	help
	  Select SSL implementation for hashing, verifying and decrypting images.

	config SWUPDATE_SSL_IMPL_NONE
		bool "None"

	config SWUPDATE_SSL_IMPL_OPENSSL
		bool "OpenSSL"
		depends on SWUPDATE_HAVE_LIBSSL

	config SWUPDATE_SSL_IMPL_WOLFSSL
		bool "wolfSSL (with OpenSSL compatibility layer)"
		depends on SWUPDATE_HAVE_WOLFSSL
		select SWUPDATE_CMS_IGNORE_CERTIFICATE_PURPOSE
		select SWUPDATE_CMS_SKIP_UNKNOWN_SIGNERS

	config SWUPDATE_SSL_IMPL_MBEDTLS
		bool "mbedTLS"
		depends on SWUPDATE_HAVE_MBEDTLS
endchoice


config SWUPDATE_CHANNEL_CURL_SSL
	bool
	depends on SWUPDATE_CHANNEL_CURL
	select SWUPDATE_CURL_SSL

config SWUPDATE_HASH_VERIFY
	bool "Allow to add sha256 hash to each image"
	depends on SWUPDATE_SSL_IMPL_OPENSSL || SWUPDATE_SSL_IMPL_WOLFSSL || SWUPDATE_SSL_IMPL_MBEDTLS
	help
	  Allow to add a sha256 hash to an artifact.
	  This is automatically set in case of Signed Image

comment "Hash checking needs an SSL implementation"
	depends on !SWUPDATE_SSL_IMPL_OPENSSL && !SWUPDATE_SSL_IMPL_WOLFSSL && !SWUPDATE_SSL_IMPL_MBEDTLS

config SWUPDATE_SIGNED_IMAGES
	bool "Enable verification of signed images"
	depends on SWUPDATE_SSL_IMPL_OPENSSL || SWUPDATE_SSL_IMPL_WOLFSSL || SWUPDATE_SSL_IMPL_MBEDTLS
	select SWUPDATE_HASH_VERIFY
comment "Image signature verification needs an SSL implementation"
	depends on !SWUPDATE_SSL_IMPL_OPENSSL && !SWUPDATE_SSL_IMPL_WOLFSSL && !SWUPDATE_SSL_IMPL_MBEDTLS

choice
	prompt "Signature verification algorithm"
	depends on SWUPDATE_SIGNED_IMAGES
	default SWUPDATE_SIGALG_RAWRSA
	help
	  Select if the signature algorithm for signed images is a raw RSA signature
	  (following PKCS#1.5) or if it uses Cryptographic Message Syntax (CMS) with
	  OpenSSL/LibreSSL or PKCS#7 with wolfSSL.
	  wolfSSL's PKCS#7 implementation can only deal with one signature and cannot
	  deal with X509 purposes.

	config SWUPDATE_SIGALG_RAWRSA
		bool "RSA PKCS#1.5"

	config SWUPDATE_SIGALG_RSAPSS
		bool "RSA PSS"

	config SWUPDATE_SIGALG_CMS
		bool "Cryptographic Message Syntax (CMS) / PKCS#7"
		depends on SWUPDATE_SSL_IMPL_OPENSSL || SWUPDATE_SSL_IMPL_WOLFSSL

	config SWUPDATE_SIGALG_GPG
		bool "GPG signing"
endchoice

menu "CMS / PKCS#7 signature verification options"
	depends on SWUPDATE_SIGALG_CMS

config SWUPDATE_CMS_IGNORE_EXPIRED_CERTIFICATE
	bool "Ignore expired certificates"
	depends on SWUPDATE_SIGALG_CMS

config SWUPDATE_CMS_IGNORE_CERTIFICATE_PURPOSE
	bool "Ignore X.509 certificate purpose"
	depends on SWUPDATE_SIGALG_CMS

config SWUPDATE_CMS_SKIP_UNKNOWN_SIGNERS
	bool "Ignore unverifiable signatures if known signer verifies"
	depends on SWUPDATE_SIGALG_CMS
endmenu


config SWUPDATE_ENCRYPTED_IMAGES
	bool "Images can be encrypted with a symmetric key"
	depends on SWUPDATE_SSL_IMPL_OPENSSL || SWUPDATE_SSL_IMPL_WOLFSSL || SWUPDATE_SSL_IMPL_MBEDTLS
comment "Image encryption needs an SSL implementation"
	depends on !SWUPDATE_SSL_IMPL_OPENSSL && !SWUPDATE_SSL_IMPL_WOLFSSL && !SWUPDATE_SSL_IMPL_MBEDTLS

config SWUPDATE_ENCRYPTED_SW_DESCRIPTION
	bool "Even sw-description is encrypted"
	depends on SWUPDATE_ENCRYPTED_IMAGES
	help
	  sw-description is not encrypted as default, but it is encrypted
	  if this is set. It is a compile time option, and mix of plain and
	  encrypted sw-descriptions is not possible.

config SWUPDATE_ENCRYPTED_IMAGES_HARDEN_LOGGING
	bool "Harden logging for encrypted images"
	default n
	depends on SWUPDATE_ENCRYPTED_IMAGES
	help
	  This option addresses a theoretical weakness of the AES-CBC encryption in
	  combination with streamed images. An adversary can target each 16-byte
	  block of encrypted data within an image and decrypt it, if they can apply a
	  huge amount of manipulated firmware updates and observe the logged
	  messages. On average, 2048 update attempts are needed for each block.
	  Select if this scenario poses a risk. If set, log messages related to a
	  hash mismatch and errors in the decryption finalization (padding) of a
	  streamed image are suppressed.

config SWUPDATE_PKCS11
	bool "Enable PKCS#11 cryptographic operations"
	default n
	depends on SWUPDATE_HAVE_WOLFSSL && SWUPDATE_HAVE_P11KIT && SWUPDATE_ENCRYPTED_IMAGES
	help
	  Enable using PKCS#11 for AES decryption instead of having the plain
	  key available in a file. This is implemented with wolfSSL independent
	  from the SSL implementation and replaces the plain key method.

comment "Compressors (zlib always on)"

config SWUPDATE_GUNZIP
	bool
	depends on SWUPDATE_HAVE_ZLIB
	default y

config SWUPDATE_ZSTD
	bool "Zstd compression support"
	depends on SWUPDATE_HAVE_ZSTD

comment "Parsers"
source "parser/Config.in"

comment "Handlers"
source "handlers/Config.in"

comment "Containers"
source "containers/Config.in"

endmenu
```
