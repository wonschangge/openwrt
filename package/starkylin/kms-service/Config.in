## package/starkylin/swupdate/config/bootloader/Config.in
```kconfig
# SPDX-FileCopyrightText: 2017 Stefano Babic <sbabic@denx.de>
#
# SPDX-License-Identifier: GPL-2.0-only

menu "Bootloader Interfaces"

config SWUPDATE_BOOTLOADER_NONE
	bool "Environment in RAM"
	default y
	help
	  This simulates the interface to a bootloader.
	  Bootloader environment is just maintained in RAM
	  and lost when SWUpdate exits.

config SWUPDATE_BOOTLOADER_EBG
	bool "EFI Boot Guard"
	depends on SWUPDATE_HAVE_LIBEBGENV
	help
	  Support for EFI Boot Guard
	  https://github.com/siemens/efibootguard

comment "EFI Boot Guard needs libebgenv and libz"
	depends on !SWUPDATE_HAVE_ZLIB || !SWUPDATE_HAVE_LIBEBGENV

config SWUPDATE_UBOOT
	bool "U-Boot"
	depends on SWUPDATE_HAVE_LIBUBOOTENV
	help
	  Support for U-Boot
	  https://www.denx.de/wiki/U-Boot

comment "U-Boot needs libubootenv"
	depends on !SWUPDATE_HAVE_LIBUBOOTENV

config SWUPDATE_UBOOT_FWENV
	string "U-Boot Environment Configuration file"
	depends on SWUPDATE_UBOOT
	default "/etc/fw_env.config"
	help
	  This is the file described in U-Boot documentation
	  in the tools directory. It tells where the U-Boot
	  environment is saved.

config SWUPDATE_UBOOT_DEFAULTENV
	string "U-Boot Initial Environment file"
	depends on SWUPDATE_UBOOT
	default "/etc/u-boot-initial-env"
	help
	  This is the file with the initial environment delivered
	  with the bootloader. It is used by SWUpdate if no environment
	  is found on the storage.

config SWUPDATE_BOOTLOADER_GRUB
	bool "GRUB"
	help
	  Support for GRUB
	  https://www.gnu.org/software/grub/

config SWUPDATE_GRUBENV_PATH
	string "GRUB Environment block file path"
	depends on SWUPDATE_BOOTLOADER_GRUB
	default "/boot/efi/EFI/BOOT/grub/grubenv"
	help
	  Provide path to GRUB environment block file

config SWUPDATE_BOOTLOADER_CBOOT
	bool "NVIDIA Tegra Cboot"
	depends on SWUPDATE_HAVE_LIBTEGRABOOT_TOOLS
	help
	  Support for NVIDIA's cboot used on some Tegra platform. Tegra
	  uses different bootloader, depending on the SOC and on the release
	  provided by vendor. Some SOCs (associated with some releases) are still
	  using U-Boot (Jetson Nano, TX, TX2), some of them are using Cboot (Xavier),
	  and some of them rely on UEFI. This adds support for cboot.

comment "Cboot needs libtegra-boot-tools"
	depends on !SWUPDATE_HAVE_LIBTEGRABOOT_TOOLS

endmenu

choice
	prompt "Default Bootloader Interface"
	help
	  Default bootloader interface to use if not explicitly
	  overridden via configuration or command-line option
	  at run-time.

config SWUPDATE_BOOTLOADER_DEFAULT_EBG
	bool "EBG"
	depends on SWUPDATE_BOOTLOADER_EBG
	help
	  Use EFI Boot Guard as default bootloader interface.
	  
	  Note: Make sure the environment modification shared
	  library https://github.com/siemens/efibootguard (including
	  dependencies) is installed on the target system.

config SWUPDATE_BOOTLOADER_DEFAULT_UBOOT
	bool "U-Boot"
	depends on SWUPDATE_UBOOT
	help
	  Use U-Boot as default bootloader interface.
	  
	  Note: Make sure the environment modification shared
	  library https://github.com/sbabic/libubootenv (including
	  dependencies) is installed on the target system.

config SWUPDATE_BOOTLOADER_DEFAULT_GRUB
	bool "GRUB"
	depends on SWUPDATE_BOOTLOADER_GRUB
	help
	  Use GRUB as default bootloader interface.

config SWUPDATE_BOOTLOADER_DEFAULT_CBOOT
	bool "Cboot"
	depends on SWUPDATE_BOOTLOADER_CBOOT
	help
	  Use NVIDIA Cboot as default bootloader interface.

config SWUPDATE_BOOTLOADER_DEFAULT_NONE
	bool "Environment in RAM"
	depends on SWUPDATE_BOOTLOADER_NONE
	help
	  Use Environment in RAM as default bootloader interface.

endchoice

config SWUPDATE_BOOTLOADER_STATIC_LINKED
	bool "Bootloader interface static linked"
	help
	  Link statically the interface to the bootloader. In case of distros,
	  more interfaces are available at the same time and SWUpdate checks
	  at runtime and loads the interface via dlopen(). This is available
	  with glibc and dlopen support. For other system, the interface can be linked
	  statically.


choice
	prompt "Update Status Storage"
	help
	  Place to persistently store the update
	  status for, e.g., communicating it to SWUpdate after
	  a reboot.

config SWUPDATE_UPDATE_STATE_CHOICE_BOOTLOADER
	bool "Bootloader"
	depends on SWUPDATE_BOOTLOADER_EBG || SWUPDATE_UBOOT || SWUPDATE_BOOTLOADER_NONE || SWUPDATE_BOOTLOADER_GRUB
	help
	  Store update status in Bootloader's environment.
	  Specify Bootloader environment variable name to store update status in.

endchoice

config SWUPDATE_UPDATE_STATE_BOOTLOADER
	string "Store Update Status in Bootloader Environment variable"
	default "ustate"
	depends on SWUPDATE_UPDATE_STATE_CHOICE_BOOTLOADER
	help
	  Store update information in Bootloader's environment.
```

## package/starkylin/swupdate/config/fs/Config.in
```kconfig
# SPDX-FileCopyrightText: 2021 Weidmueller Interface GmbH & Co. KG
#
# SPDX-License-Identifier: GPL-2.0-only

if SWUPDATE_DISKFORMAT
config SWUPDATE_FAT_FILESYSTEM
	bool "FAT file system creation support"
	default n
	help
	  Enable support for creating FAT file systems.

config SWUPDATE_EXT_FILESYSTEM
	bool "EXT2 / EXT3 / EXT4 file system creation support"
    depends on SWUPDATE_HAVE_LIBEXT2FS
	default n
	help
	  Enable support for creating EXT file systems.

comment "EXT2 / EXT3 / EXT4 file system creation support needs libext2fs"
    depends on !SWUPDATE_HAVE_LIBEXT2FS

config SWUPDATE_BTRFS_FILESYSTEM
	bool "BTRFS file system creation support"
    depends on SWUPDATE_HAVE_LIBBTRFS
	default n
	help
	  Enable support for creating BTRFS file systems.

comment "BTRFS file system creation support needs libbtrfs libbtrfsutil"
    depends on !SWUPDATE_HAVE_LIBBTRFS

config SWUPDATE_BTRFS_FILESYSTEM_USELIBMKFS
	bool "Use modified source from btrfs tool to be linked as lib"
    depends on SWUPDATE_HAVE_LIBBTRFS
	default n
	help
	  This requires at the moment a patched version of btrfs-tool to export
	  mkfs.btrfs as library.

comment "BTRFS file system creation support needs libbtrfs libbtrfsutil"
    depends on !SWUPDATE_HAVE_LIBBTRFS

endif
```

## package/starkylin/swupdate/config/handlers/Config.in
```kconfig
# SPDX-FileCopyrightText: 2013 Stefano Babic <sbabic@denx.de>
#
# SPDX-License-Identifier: GPL-2.0-only

#
# For a description of the syntax of this configuration file,
# see scripts/kbuild/config-language.txt.
#

menu "Image Handlers"

config SWUPDATE_ARCHIVE
	bool "archive"
	depends on SWUPDATE_HAVE_LIBARCHIVE
	default n
	help
	  Handler using the libarchive to extract tarballs
	  into a filesystem.

comment "archive support needs libarchive"
	depends on !SWUPDATE_HAVE_LIBARCHIVE

config SWUPDATE_LOCALE
	bool "Locale support for filenames"
	depends on SWUPDATE_ARCHIVE
	default y
	help
	  Option to remove attempts to use locale in systems
	  without locale support in toolchain.

config SWUPDATE_BOOTLOADERHANDLER
	bool "bootloader"
	default y
	help
	  Enable it to change bootloader environment
	  during the installation process.

config SWUPDATE_CFI
	bool "cfi"
	depends on SWUPDATE_MTD
	default n
	help
	  Handler to store images in flash in raw mode,
	  without UBI

config SWUPDATE_CFIHAMMING1
	bool "NAND in raw mode with 1bit Hamming OOB (TI)"
	depends on SWUPDATE_MTD
	default n
	help
	  On certain TI's omaps (for example, DM3730 or AM3517),
	  the first bootloader (MLO or SPL) must be saved with one bit
	  Hamming correction because this is requested by the SOC's ROM.
	  However, the Linux driver must use for the rest of the NAND a more
	  powerful algorithm to make data reliable, and this causes that
	  it is not possible to update SPL by letting the driver to handle
	  the OOB area. This handler raws the NAND in raw mode, computing
	  the ECC with 1 bit Hamming Code and saving it into OOB
	  (assumes sector size of 512 and page size of 2048).

	  You do not need this if you do not have an OMAP SoC.

config SWUPDATE_COPY
	bool "copy"
	default n
	help
	  This works as script and copies files / images to a
	  different destination. It requires a chained handler
	  so that it works even with flash or special devices.

config SWUPDATE_DELTA
	bool "delta"
	depends on SWUPDATE_HAVE_LIBCURL
	depends on SWUPDATE_HAVE_ZSTD
	depends on SWUPDATE_HAVE_ZCK
	select SWUPDATE_CHANNEL_CURL
	default n
	help
	  Handler to enable delta images. The handler computes the differences
	  and download the missing parts, and pass the resulting image to the
	  next handler.

config SWUPDATE_DISKPART
	bool "diskpart"
	depends on SWUPDATE_HAVE_LIBFDISK
	default n
	help
	  Handler to partition a disk, eMMC or SD

comment "diskpart support needs libfdisk"
	depends on !SWUPDATE_HAVE_LIBFDISK

config SWUPDATE_DISKPART_FORMAT
	bool "diskpart extension for creating file systems"
	depends on SWUPDATE_DISKPART
	select SWUPDATE_DISKFORMAT
	default n
	help
	  This extension allows formatting newly created partitions.

config SWUPDATE_DISKFORMAT_HANDLER
	bool "diskformat handler for creating file systems"
	select SWUPDATE_DISKFORMAT
	default n
	help
	  The diskformat handler allows creating filesystems on empty
	  partitions.

source "../fs/Config.in"

config SWUPDATE_LUASCRIPTHANDLER
	bool "Lua Script"
	depends on SWUPDATE_LUA
	default n
	help
	  Handler to be called for pre- and post scripts
	  written in Lua.

config SWUPDATE_EMBEDDED_LUA_HANDLER
	bool "Embed Lua handler in SWUpdate binary"
	depends on SWUPDATE_LUA
	default n
	help
	  Embed the Lua handler source code file into the
	  SWUpdate binary.

	  If enabled, a swupdate_handlers.lua will *not*
	  be loaded from disk at SWUpdate startup.

	  Note: Exactly one Lua source code file is embedded
	  into the binary, i.e., possible dependencies either
	  have to be deployed on the target system or put into
	  the one embedded Lua source code file.

config SWUPDATE_EMBEDDED_LUA_HANDLER_SOURCE
	string "Lua handler file"
	depends on SWUPDATE_EMBEDDED_LUA_HANDLER
	default "swupdate_handlers.lua"
	help
	  Path to the Lua handler source code file to be
	  embedded into the SWUpdate binary.

config SWUPDATE_RAW
	bool "raw"
	default y
	help
	  This is a simple handler that simply copies
	  into the destination.

config SWUPDATE_RDIFFHANDLER
	bool "rdiff"
	depends on SWUPDATE_HAVE_LIBRSYNC
	default n
	help
	  Add support for applying librsync's rdiff patches,
	  see http://librsync.sourcefrog.net/

comment "rdiff support needs librsync"
	depends on !SWUPDATE_HAVE_LIBRSYNC

config SWUPDATE_READBACKHANDLER
	bool "readback"
	depends on SWUPDATE_HASH_VERIFY
	default n
	help
	  To verify that an image was written properly, this readback handler
	  calculates the sha256 hash of a partition (or part of it) and compares
	  it against a given hash value.

	  This is a post-install handler running at the same time as
	  post-install scripts.

config SWUPDATE_REMOTE_HANDLER
	bool "Remote handler"
	depends on SWUPDATE_HAVE_LIBZEROMQ
	default n
	help
	  Sometimes the update process should be done
	  by another process, where code is already
	  provided. The remote handler let communicate
	  an external process with SWUpdate, sending
	  the image to be updated with the help of the
	  zeromq library.

comment "remote handler needs zeromq"
	depends on !SWUPDATE_HAVE_LIBZEROMQ

config SWUPDATE_SHELLSCRIPTHANDLER
	bool "shellscript"
	default n
	help
	  Handler to be called for pre- and post scripts
	  written as shell scripts. The default shell /bin/sh
	  is called.

config SWUPDATE_SWUFORWARDER_HANDLER
	bool "SWU forwarder"
	depends on SWUPDATE_HAVE_LIBCURL
	depends on SWUPDATE_HAVE_LIBWEBSOCKETS
	depends on SWUPDATE_HAVE_URIPARSER
	select SWUPDATE_CHANNEL_CURL
	default n
	help
	  This allows one to build a chain of updater. A
	  SWU can contain other SWUs for other systems.
	  The handler takes a list of URLs and forwards the
	  embedded SWU to the other devices using the
	  webserver REST API.

comment "swuforward handler needs libcurl"
	depends on !SWUPDATE_HAVE_LIBCURL

comment "swuforward handler needs websockets and uriparser"
	depends on !SWUPDATE_HAVE_LIBWEBSOCKETS || !HAVE_URIPARSER

config SWUPDATE_SSBLSWITCH
	bool "Second Stage Switcher"
	depends on SWUPDATE_MTD
	default n
	help
	  This handler allows one to switch between two software sets
	  based on an administration block stored in flash (CFI interface).
	  It works like the switch of UBI and allows one to switch in an atomic
	  way between two software sets. It can be used to reliably update
	  a second stage bootloader.

config SWUPDATE_UBIVOL
	bool "ubivol"
	default n
	depends on SWUPDATE_HAVE_LIBUBI
	depends on SWUPDATE_MTD
	help
	  ubi is the default format for NAND device.
	  Say Y if you have NAND or you use UBI on
	  your system.

comment "ubivol support needs libubi"
	depends on !SWUPDATE_HAVE_LIBUBI

config SWUPDATE_UBIATTACH
	bool "Automatically attach UBI devices"
	default y
	depends on SWUPDATE_UBIVOL
	help
	  If this option is enabled, swupdate will try to attach
	  UBI devices to all MTD devices.

	  Make sure UBIBLACKLIST or UBIWHITELIST is set correctly,
	  since attaching a UBI device will write to it if it is
	  found to be empty, and that may destroy already existing
	  content on that device.

config SWUPDATE_UBIBLACKLIST
	string "List of MTD devices to be excluded for UBI"
	depends on SWUPDATE_UBIATTACH
	help
	  Define a list of MTD devices that are excluded
	  by scan_mtd_device. The devices are still available
	  as raw devices.
	  The list can be set as a string with the mtd numbers.
	  Examples: "0 1 2"
	  This excludes mtd0-mtd1-mtd2 to be searched for UBI volumes

config SWUPDATE_UBIWHITELIST
	string "List of MTD devices that must have UBI"
	depends on SWUPDATE_UBIATTACH
	help
	  Define a list of MTD devices that are planned to have
	  always UBI. If first attach fails, the device is erased
	  and tried again.
	  The list can be set as a string with the mtd numbers.
	  Examples: "0 1 2"
	  This sets mtd0-mtd1-mtd2 to be used as UBI volumes.
	  UBIBLACKLIST has priority on UBIWHITELIST.

config SWUPDATE_UBIVIDOFFSET
	int "VID Header Offset"
	depends on SWUPDATE_UBIATTACH
	default 0
	help
	  Force UBI to set a VID header offset to be 2048 bytes
	  instead of the value reported by the kernel.
	  In other words, you may ask UBI to avoid using sub-pages.
	  This is not recommended since this will require
	  more storage overhead, but may be useful
	  if your NAND driver incorrectly reports that it can handle
	  sub-page accesses when it should not.

config SWUPDATE_UCFWHANDLER
	bool "microcontroller firmware update"
	depends on SWUPDATE_HAVE_LIBGPIOD
	default n
	help
	  Simple protocol to upgrade a microcontroller
	  via UART.

comment "Microcontroller handler depends on libgpiod"
	depends on !SWUPDATE_HAVE_LIBGPIOD

config SWUPDATE_UNIQUEUUID
	bool "uniqueuuid"
	depends on SWUPDATE_HAVE_LIBBLKID
	default n
	help
	  This handler checks that no filesystem on the device has
	  a UUID from a list (list is added as part of "properties"
	  in sw-description) for this handler.
	  This is useful for bootloader (like GRUB) that use UUID to
	  select the partition to be started, and in case two or
	  more filesystem have the same UUID, a wrong one is started.
	  This handler is a partition handler and it is guaranteed that
	  it runs before any image is installed on the device.

comment "uniqueuuid support needs libblkid"
	depends on !SWUPDATE_HAVE_LIBBLKID

endmenu
```
