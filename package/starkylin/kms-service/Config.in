## package/starkylin/swupdate/config/mongoose/Config.in
```kconfig
# SPDX-FileCopyrightText: 2013 Stefano Babic <sbabic@denx.de>
#
# SPDX-License-Identifier: GPL-2.0-only

menuconfig SWUPDATE_WEBSERVER
	bool "Web Server"
	select SWUPDATE_MONGOOSE
	help
	  Enable update from remote using a web server on the target.

if SWUPDATE_WEBSERVER
choice
	prompt "Web Server Type"
	default SWUPDATE_MONGOOSE
	help
	  Choose the web server

config SWUPDATE_MONGOOSE
	bool "mongoose"
	help
	  Mongoose embeddded web server

endchoice

config SWUPDATE_MONGOOSEIPV6
	bool "IPv6 support"
	default y
	depends on SWUPDATE_MONGOOSE
	help
	   It enables ipv6 support into mongoose

config SWUPDATE_MONGOOSESSL
	bool "SSL support"
	depends on SWUPDATE_MONGOOSE
	depends on SWUPDATE_SSL_IMPL_OPENSSL || SWUPDATE_SSL_IMPL_WOLFSSL || SWUPDATE_SSL_IMPL_MBEDTLS
	help
	   It enables SSL support into mongoose

comment "SSL support needs an SSL implementation"
	depends on !SWUPDATE_SSL_IMPL_OPENSSL && !SWUPDATE_SSL_IMPL_WOLFSSL && !SWUPDATE_SSL_IMPL_MBEDTLS

endif
```

## package/starkylin/swupdate/config/parser/Config.in
```kconfig
# SPDX-FileCopyrightText: 2013 Stefano Babic <sbabic@denx.de>
#
# SPDX-License-Identifier: GPL-2.0-only

menu "Parser Features"

config SWUPDATE_LIBCONFIG
	bool "libconfig"
	default y
	depends on SWUPDATE_HAVE_LIBCONFIG
	help
	  Use libconfig to parse the configuration file.
	  This is the default parser.

comment "Default config parser support needs libconfig"
	depends on !SWUPDATE_HAVE_LIBCONFIG

config SWUPDATE_PARSERROOT
	string "Name of root node"
	help
	  For compatibility reasons, the root node
	  can be set to something else as "software".
	  In most case you do not need to set it.

config SWUPDATE_LUAEXTERNAL
	bool "lua"
	depends on SWUPDATE_LUA
	default n
	help
	  call an external parser written in Lua.

config SWUPDATE_SETEXTPARSERNAME
	bool "Set external parser name"
	depends on SWUPDATE_LUAEXTERNAL
	default n
	help
	  Set to define own path and filename for the
	  external parser, else default lua-tools/extparser.lua
	  will be used.

config SWUPDATE_EXTPARSERNAME
	string "External parser file name"
	depends on SWUPDATE_SETEXTPARSERNAME
	help
	  Lua script to be executed for parsing
	  the sw-description file.

config SWUPDATE_SETSWDESCRIPTION
	bool "set file description name"
	default n
	help
	  Set it if you want to change the name of
	  the default software descritpion file.
	  If not set, default file name is "sw-description"

config SWUPDATE_SWDESCRIPTION
	string "description file"
	depends on SWUPDATE_SETSWDESCRIPTION
	help
	   File extracted from the image containing
	   the description (meta) of the images.
	   This file, after extraction, is passed to the parser.
endmenu
```

## package/starkylin/swupdate/config/suricatta/Config.in
```kconfig
# SPDX-FileCopyrightText: 2016 Christian Storm <christian.storm@tngtech.com>
#
# SPDX-License-Identifier: GPL-2.0-only

menuconfig SWUPDATE_SURICATTA
	bool "Suricatta"
	depends on SWUPDATE_HAVE_LIBCURL
	select SWUPDATE_CHANNEL_CURL
	help
	  Suricatta is a daemon mode of SWUpdate.

	  Suricatta regularly polls a remote server for updates,
	  downloads, and installs them. Thereafter, it reboots the
	  system and reports the update status to the server, based
	  on an update state variable currently stored in bootloader’s
	  environment ensuring persistent storage across reboots. Some
	  U-Boot script logics or U-Boot’s bootcount feature may be
	  utilized to alter this update state variable, e.g., by
	  setting it to reflect failure in case booting the newly
	  flashed root file system has failed and a switchback had to
	  be performed.

if SWUPDATE_SURICATTA

menu "Features"

config SWUPDATE_SURICATTA_SSL
	bool "SSL support"
	default n
	depends on SWUPDATE_SSL_IMPL_OPENSSL || SWUPDATE_SSL_IMPL_WOLFSSL || SWUPDATE_SSL_IMPL_MBEDTLS
	select SWUPDATE_CHANNEL_CURL_SSL
	help
	  Enable SSL and checksum verification support in suricatta.

comment "SSL support needs an SSL implementation"
	depends on !(SWUPDATE_SSL_IMPL_OPENSSL || SWUPDATE_SSL_IMPL_WOLFSSL || SWUPDATE_SSL_IMPL_MBEDTLS)

endmenu

menu "Server"

config SWUPDATE_SURICATTA_HAWKBIT
	bool "hawkBit support"
	default y
	help
	  Support for hawkBit server.
	  https://projects.eclipse.org/projects/iot.hawkbit

config SWUPDATE_SURICATTA_LUA
	bool "Suricatta Lua module"
	depends on SWUPDATE_HAVE_LUA
	select SWUPDATE_CHANNEL_CURL
	select SWUPDATE_LUA
	help
	  Support for Suricatta modules in Lua.

	  The JSON support for Suricatta Lua modules
	  provides JSON as Lua Tables to the Lua realm and
	  enables channel result parsing to JSON per default.
	  To enable, select 'libjson' in 'Parser Features'.

config SWUPDATE_SURICATTA_WFX
	bool "wfx support"
	depends on SWUPDATE_SURICATTA_LUA
	select SWUPDATE_EMBEDDED_SURICATTA_LUA
	help
	  Support for wfx server.
	  https://www.github.com/siemens/wfx

config SWUPDATE_EMBEDDED_SURICATTA_LUA
	bool "Embed Suricatta Lua module in SWUpdate binary"
	depends on SWUPDATE_SURICATTA_LUA
	help
	  Embed the Suricatta Lua module source code file into
	  the SWUpdate binary.

	  If enabled, a swupdate_suricatta.lua will *not*
	  be loaded from disk at SWUpdate startup.

	  Note: Exactly one Lua source code file is embedded
	  into the binary, i.e., possible dependencies either
	  have to be deployed on the target system or put into
	  the one embedded Lua source code file.

config SWUPDATE_EMBEDDED_SURICATTA_LUA_SOURCE
	string "Suricatta Lua module file"
	depends on SWUPDATE_EMBEDDED_SURICATTA_LUA
	default "swupdate_suricatta.lua" if !SWUPDATE_SURICATTA_WFX
	default "suricatta/server_wfx.lua" if SWUPDATE_SURICATTA_WFX
	help
	  Path to the Suricatta Lua module source code file to
	  be embedded into the SWUpdate binary.

config SWUPDATE_SURICATTA_GENERAL
	bool "General HTTP support"
	help
	  Support for Simple HTTP coded server
	  The server uses HTTP return codes to detect if an update
	  is available. See documentation for more details.

endmenu

comment "Suricatta Lua module support needs Lua"
	depends on !SWUPDATE_HAVE_LUA

comment "Suricatta daemon support needs libcurl"
	depends on !SWUPDATE_HAVE_LIBCURL

endif
```
